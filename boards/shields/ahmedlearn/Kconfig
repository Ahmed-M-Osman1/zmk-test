## boards/shields/ahmedlearn/Kconfig
```kconfig
# Copyright (c) 2020 The ZMK Contributors
# SPDX-License-Identifier: MIT

rsource "../../../config/drivers/Kconfig"
```

## boards/shields/ahmedlearn/Kconfig.defconfig
```kconfig
if SHIELD_AHMEDLEARN

# Name must be less than 16 characters long!
config ZMK_KEYBOARD_NAME
    default "ahmedlearn"

config IQS5XX
    bool
    default y

config I2C
    bool
    default y

config IQS5XX_THREAD_PRIORITY
    int "IQS5XX thread priority"
    default 100

config IQS5XX_INTERRUPT
    bool "Enable IQS5XX interrupt mode"
    default y

endif
```
